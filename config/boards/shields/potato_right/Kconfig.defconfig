## config/boards/shields/potato_right/Kconfig.defconfig
```kconfig
if SHIELD_POTATO_RGHT_ONLY

    config ZMK_KEYBOARD_NAME
        default "potato_rght_only"

    config BT
        default y

endif
```

## config/boards/shields/potato_right/Kconfig.shield
```kconfig
config SHIELD_POTATO_RGHT_ONLY
    def_bool $(shields_list_contains, potato_rght_only)
```
